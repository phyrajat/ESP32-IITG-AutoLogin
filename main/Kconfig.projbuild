## main/Kconfig.projbuild
```kconfig
menu "IITG AutoLogin"

    config STATUS_LED_GPIO
        int "Status LED GPIO number"
        range 0 33
        default 2
        help
            GPIO that drives a plain (non-addressable) status LED. The
            default suits classic ESP32 dev kits; set it for your board.

    config STATUS_LED_ACTIVE_LOW
        bool "Status LED is active low"
        default n
        help
            Enable if the LED lights when the GPIO is driven low.

    config XIAO_ESP32C6_ANTENNA_SWITCH
        bool "Enable the Seeed XIAO ESP32C6 antenna switch"
        default n
        help
            The XIAO ESP32C6 routes its radio through an RF switch that is
            powered by driving GPIO 3 low; GPIO 14 then selects the antenna.
            Without this the radio has almost no range.

    config XIAO_ESP32C6_EXTERNAL_ANTENNA
        bool "Use the external (U.FL) antenna"
        depends on XIAO_ESP32C6_ANTENNA_SWITCH
        default n
        help
            Select the external antenna connector instead of the on-board
            ceramic antenna.

endmenu
```
